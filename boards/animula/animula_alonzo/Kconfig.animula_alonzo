## boards/animula/animula_alonzo/Kconfig.animula_alonzo
```kconfig
# Copyright (c) 2026 HardenedLinux Animula
# Author: Nala Ginrut <roy@hardenedlinux.org>
#
# SPDX-License-Identifier: GPL-3.0-or-later

config BOARD_ANIMULA_ALONZO
	select SOC_STM32F411XE
	# The bootloader bit-bangs SWD on PA2/PA3 (USART2) and must re-apply
	# USART2's pinctrl state to restore the BLE UART after programming.
	select PINCTRL_NON_STATIC

config ALONZO_BOOTLOADER_SIZE
	hex "Reserved bootloader flash size (bytes)"
	default 0x20000
	help
	  Flash size reserved for the Maker Bootloader. The application is
	  linked immediately after it: APP_START = FLASH_BASE + this size.

	  Must be sector-aligned on the STM32F411CEU6 (S0..S3 = 16 KB each,
	  S4 = 64 KB, S5..S7 = 128 KB each). Valid values are:
	    0x04000 (16 KB)   0x08000 (32 KB)   0x0C000 (48 KB)
	    0x10000 (64 KB)   0x20000 (128 KB)  0x40000 (256 KB)
	    0x60000 (384 KB)  0x80000 (512 KB)

	  Keep this in sync with CONFIG_FLASH_LOAD_SIZE in the bootloader's
	  prj.conf (and CONFIG_FLASH_LOAD_OFFSET in the application); a
	  mismatch is caught by a build-time assertion in memory_layout.h.
```

## boards/animula/animula_alonzo/animula_alonzo_defconfig
```kconfig
# Copyright (c) 2026 HardenedLinux Animula
# Author: Nala Ginrut <roy@hardenedlinux.org>
#
# SPDX-License-Identifier: GPL-3.0-or-later

# Enable MPU
CONFIG_ARM_MPU=y

# Enable HW stack protection
CONFIG_HW_STACK_PROTECTION=y

# Serial drivers and console
CONFIG_SERIAL=y
CONFIG_UART_INTERRUPT_DRIVEN=y
CONFIG_CONSOLE=y
CONFIG_UART_CONSOLE=y

# Enable GPIO
CONFIG_GPIO=y
```

## boards/animula/animula_alonzo/board.yml
```yaml
# Copyright (c) 2026 HardenedLinux Animula
# Author: Nala Ginrut <roy@hardenedlinux.org>
#
# SPDX-License-Identifier: GPL-3.0-or-later

board:
  name: animula_alonzo
  full_name: Animula Alonzo
  vendor: animula
  socs:
    - name: stm32f411xe
```
